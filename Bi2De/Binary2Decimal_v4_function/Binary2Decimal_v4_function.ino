/*

  This sketch converts an 8-Bit Binary number into a Decimal number.
  The Binary number is fed to the Arduino through an 8x DIP Switch.
  A function then converts this Binary number to its Decimal
  equivalent. These numbers are displayed on an OLED Display and Serial Monitor.

  This program is made by Shreyas for Electronics Champ YouTube Channel.
  Please subscribe to this channel. Thank You.

*/

//Include the libraries
#include <Wire.h>
#include <Adafruit_GFX.h>
#include <Adafruit_SSD1306.h>

//Initialize the variables
int bitVal;
String stringBit;
String stringBinary;
long binaryNumber;
int decimalNumber;

#define SCREEN_WIDTH 128
#define SCREEN_HEIGHT 64

Adafruit_SSD1306 oled(SCREEN_WIDTH, SCREEN_HEIGHT);

//Prints the HEC5 logo on OLED Display
static const uint8_t PROGMEM logo[] = {
  0x00, 0x00, 0x00, 0x00, 0x00, 0x00, 0x00, 0x00, 0x00, 0x00, 0x00, 0x00, 0x00, 0x00, 0x00, 0x00, 
  0x00, 0x00, 0x00, 0x00, 0x00, 0x00, 0x00, 0x00, 0x00, 0x00, 0x00, 0x00, 0x00, 0x00, 0x00, 0x00, 
  0x00, 0x00, 0x00, 0x00, 0x00, 0x00, 0x00, 0x00, 0x00, 0x00, 0x00, 0x00, 0x00, 0x00, 0x00, 0x00, 
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  0x00, 0x00, 0x00, 0x00, 0x00, 0x00, 0x00, 0x00, 0x00, 0x00, 0x00, 0x00, 0x00, 0x00, 0x00, 0x00
};
void setup() {

  Serial.begin(9600);

  //Sets pin 3 to pin 10 as input
  for (int x = 3; x < 7; x++) {

    pinMode(x, INPUT);

  }

  oled.begin(SSD1306_SWITCHCAPVCC, 0x3C);
  oled.clearDisplay();

  //Prints the logo on OLED Display
  oled.drawBitmap(0, 0, logo, 128, 64, 1);
  oled.display();
  delay(9000);
  oled.clearDisplay();

}

void loop() {

  //Reads the Binary number from the DIP Switch
  for (int x = 3; x < 7; x++) {
    bitVal = digitalRead(x);
    stringBit = String(bitVal);
    stringBinary = stringBinary + stringBit;
    binaryNumber = stringBinary.toInt();
}

  //Function to convert Binary to Decimal
  decimalNumber = convertBinaryToDecimal(binaryNumber);
  //Function to display current position
  Position();

  if (decimalNumber=1) {Serial.print("Test1");}
  else if (decimalNumber=2) {Serial.print("Test2");}
  else  {Serial.print("Test else");}
}

//Function Postion
void Position(){
   //Prints the Binary number on the Serial Monitor
  Serial.print("Binary: ");
  Serial.print(stringBinary);
  Serial.print("      ");
  //Prints the Decimal number on the Serial Monitor
  Serial.print("Decimal: ");
  Serial.println(decimalNumber);
  //Prints the Binary number on the OLED Display
  oled.clearDisplay();
  oled.setTextSize(1);
  oled.setTextColor(WHITE);
  oled.setCursor(5, 10);
  oled.print("HEC5-UTTyler");  
  oled.setCursor(5, 20);
  oled.print("NASA-TSGC Design");  
  oled.setCursor(5, 00);
  oled.print("-Year2022-"); 
  oled.setCursor(5, 40);
  oled.print("Binary:");
  oled.println(stringBinary);
  //Prints the Decimal number on the OLED Display
  oled.setTextSize(1);
  oled.setTextColor(WHITE);
  oled.setCursor(5, 50);
  oled.print("Position:");
  oled.println(decimalNumber);
  oled.display();
  oled.startscrollright(0x00,0x00);
  delay(3000);
  oled.clearDisplay();
  oled.clearDisplay(); 
  //Resets all the variables
  binaryNumber = 0;
  bitVal = 0;
  stringBit = "";
  stringBinary = "";
}

//Function to convert Binary to Decimal
long convertBinaryToDecimal(long binary) {

  long number = binary;
  long decimalVal = 0;
  long baseVal = 1;
  long tempVal = number;
  long previousDigit;

  while (tempVal) {

    //Converts Binary to Decimal
    previousDigit = tempVal % 10;
    tempVal = tempVal / 10;
    decimalVal += previousDigit * baseVal;
    baseVal = baseVal * 2;

  }

  //Returns the Decimal number
  return decimalVal;

}
